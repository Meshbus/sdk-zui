## samples/assets/sample.yaml
```yaml
sample:
  name: ZUI assets sample
tests:
  sample.subsys.zui.assets:
    build_only: true
    platform_allow:
      - mesh_probe_r2/nrf54l15/cpuapp
    tags:
      - zui
      - assets
```

## samples/component/sample.yaml
```yaml
sample:
  name: ZUI component sample
tests:
  sample.subsys.zui.component:
    build_only: true
    platform_allow:
      - mesh_probe_r2/nrf54l15/cpuapp
    tags:
      - zui
      - component
```

## samples/draw/sample.yaml
```yaml
sample:
  description: ZUI draw primitive visual sample
  name: zui draw sample
common:
  tags: [zui, draw]
  build_only: true
tests:
  sample.zui.draw:
    integration_platforms:
      - mesh_probe_r2/nrf54l15/cpuapp
```

## samples/host/sample.yaml
```yaml
sample:
  description: ZUI host/router state-machine sample
  name: zui host sample
common:
  tags: [zui, host]
  build_only: true
tests:
  sample.zui.host:
    integration_platforms:
      - mesh_probe_r2/nrf54l15/cpuapp
```

## samples/input/sample.yaml
```yaml
sample:
  name: ZUI input sample
tests:
  sample.subsys.zui.input:
    build_only: true
    platform_allow:
      - mesh_probe_r2/nrf54l15/cpuapp
    tags:
      - zui
      - input
```

## samples/screen/sample.yaml
```yaml
sample:
  description: ZUI screen lifecycle and forwarding sample
  name: zui screen sample
common:
  tags: [zui, screen]
  build_only: true
tests:
  sample.zui.screen:
    integration_platforms:
      - mesh_probe_r2/nrf54l15/cpuapp
```

## samples/toast/sample.yaml
```yaml
sample:
  description: ZUI toast animation sample
  name: zui toast sample
common:
  tags: [zui, toast]
  build_only: true
tests:
  sample.zui.toast:
    integration_platforms:
      - mesh_probe_r2/nrf54l15/cpuapp
```
